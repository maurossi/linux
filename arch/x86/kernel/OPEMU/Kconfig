## drivers/staging/media/atomisp/i2c/Kconfig
```kconfig
#
# Kconfig for sensor drivers
#

config VIDEO_ATOMISP_MSRLIST_HELPER
       tristate "Helper library to load, parse and apply large register lists."
       depends on I2C
       ---help---
	 This is a helper library to be used from a sensor driver to load, parse
	 and apply large register lists.

	 To compile this driver as a module, choose M here: the
	 module will be called libmsrlisthelper.

config VIDEO_ATOMISP_MT9M114
       tristate "Aptina mt9m114 sensor support"
	depends on ACPI
       depends on I2C && VIDEO_V4L2
       ---help---
	 This is a Video4Linux2 sensor-level driver for the Micron
	 mt9m114 1.3 Mpixel camera.

	 mt9m114 is video camera sensor.

	 It currently only works with the atomisp driver.
```
